## sdkconfig.defaults
```kconfig
# Default sdkconfig for betaflight-bridge (ESP32-S3)
# Generated values land in ./sdkconfig; these are the project defaults.

# --- Target ---
CONFIG_IDF_TARGET="esp32s3"

# --- USB Host (OTG) ---
# The S3 OTG peripheral acts as USB host to drive the FC's CDC-ACM (VCP).
CONFIG_USB_HOST_CONTROL_TRANSFER_MAX_SIZE=256
CONFIG_USB_HOST_HW_BUFFER_BIAS_IN=y

# --- FreeRTOS ---
CONFIG_FREERTOS_HZ=1000

# --- Main task / app ---
# Roomy: app_main generates the self-signed TLS cert on first boot (mbedTLS
# key/cert writing is stack-hungry).
CONFIG_ESP_MAIN_TASK_STACK_SIZE=10240

# --- HTTP server ---
# WebSocket support: the web UI serves a ws:// (and wss:// over TLS) serial
# endpoint so browsers can bridge to the FC (browsers can't open raw TCP).
CONFIG_HTTPD_WS_SUPPORT=y
# Desktop browsers (Edge/Chrome) send a large header block — sec-ch-ua*,
# sec-fetch-*, priority, long Accept/User-Agent — that overflows the 512-byte
# default and trips "Header fields are too long". 2 KB clears a real request.
CONFIG_HTTPD_MAX_REQ_HDR_LEN=2048

# --- TLS ---
# Browsers and curl send TLS 1.3-capable ClientHellos by default. A 1.2-only
# mbedTLS server drops these instead of negotiating down, so the HTTPS UI and
# wss:// serial endpoint reset the connection. Enable 1.3 server support so a
# browser can reach https://<ip>/ and wss://<ip>/serial.
CONFIG_MBEDTLS_SSL_PROTO_TLS1_3=y

# --- WiFi ---
CONFIG_ESP_WIFI_SOFTAP_SUPPORT=y
# Bump TX/RX buffers a little so the MSP byte bridge doesn't stall under load.
CONFIG_ESP_WIFI_STATIC_RX_BUFFER_NUM=16
CONFIG_ESP_WIFI_DYNAMIC_RX_BUFFER_NUM=32
CONFIG_ESP_WIFI_DYNAMIC_TX_BUFFER_NUM=32

# --- lwIP ---
# Disable Nagle so small MSP frames are flushed immediately (low latency).
CONFIG_LWIP_TCP_MSL=6000

# --- OTA ---
# Boot a freshly-OTA'd image in pending-verify state; if it doesn't mark itself
# valid (see esp_ota_mark_app_valid_cancel_rollback in main.c) the bootloader
# rolls back to the previous slot on the next reset.
CONFIG_BOOTLOADER_APP_ROLLBACK_ENABLE=y

# --- Partitions ---
# Flash size, the partition-table CSV, and PSRAM are board-specific; see
# boards/<board>/sdkconfig.defaults (selected with -DBOARD=<board>).
CONFIG_PARTITION_TABLE_CUSTOM=y

# --- Logging ---
CONFIG_LOG_DEFAULT_LEVEL_INFO=y
```
