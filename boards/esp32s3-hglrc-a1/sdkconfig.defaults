## src/main/Kconfig.projbuild
```kconfig
menu "Betaflight bridge"

    choice BRIDGE_DISPLAY
        prompt "Status display"
        default BRIDGE_DISPLAY_NONE
        help
            Which on-board display the bridge drives, if any. Selected
            per-board via the board's sdkconfig.defaults. Both variants reach
            their panel through the board's board_display.h.

        config BRIDGE_DISPLAY_NONE
            bool "None"
            help
                No on-board display; display_start() is a no-op.

        config BRIDGE_DISPLAY_TOUCH
            bool "Touch status display"
            help
                Drive a large on-board LCD with a native LVGL touch UI showing
                the bridge status (FC link, app client, WiFi, IP) and offering
                WiFi scan/join.

        config BRIDGE_DISPLAY_COMPACT
            bool "Compact status display"
            help
                Drive a small on-board LCD with a read-only LVGL status screen:
                FC link, client, WiFi, connect URLs and a QR code. The board
                must also supply the assets display.c expects — see "Adding a
                board" in the README.

    endchoice

    config BRIDGE_ADC_VOLTAGE
        bool "Input voltage monitor"
        default n
        help
            Sample the board's input-voltage divider and show the result on
            the status display. Requires the board to define BOARD_ADC_GPIO
            and BOARD_ADC_DIVIDER_RATIO and to provide adc_voltage.c.

    config BRIDGE_WEB_I18N
        bool "Bilingual web UI"
        default n
        help
            Serve the English/Chinese web page with a light/dark theme toggle
            instead of the default English-only dark page.

endmenu
```
